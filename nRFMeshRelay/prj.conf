## prj.conf
```kconfig
CONFIG_ADC=y
CONFIG_ADC_ASYNC=y
CONFIG_GPIO=y
CONFIG_STDOUT_CONSOLE=y
CONFIG_PRINTK=y
CONFIG_PWM=y
CONFIG_LOG_PRINTK=y
CONFIG_LOG_MODE_IMMEDIATE=y
CONFIG_PWM_LOG_LEVEL_DBG=y
CONFIG_NEWLIB_LIBC=y
CONFIG_ADC_NRFX_SAADC=y
CONFIG_NRFX_SAADC=y
CONFIG_LOG=y
CONFIG_PM=y
CONFIG_PM_DEVICE=y
#CONFIG_TRACING_SYSCALL=y


CONFIG_BT=y
CONFIG_BT_PERIPHERAL=y
CONFIG_BT_DEVICE_NAME="VISENSE_TEST"
CONFIG_BT_CTLR_ADV_EXT=y
CONFIG_BT_EXT_ADV=y
CONFIG_BT_CTLR_ADV_DATA_LEN_MAX=225
CONFIG_BT_USER_DATA_LEN_UPDATE=y
#CONFIG_BT_USER_PHY_UPDATE=y
CONFIG_BT_GAP_AUTO_UPDATE_CONN_PARAMS=n
CONFIG_HEAP_MEM_POOL_SIZE=4096
CONFIG_BT_BUF_ACL_RX_SIZE=251
CONFIG_BT_ATT_PREPARE_COUNT=2
CONFIG_BT_L2CAP_TX_MTU=247

CONFIG_BT_BUF_ACL_TX_COUNT=10
CONFIG_BT_BUF_ACL_TX_SIZE=251
#CONFIG_BT_AUTO_PHY_UPDATE=y
CONFIG_BT_CTLR_DATA_LENGTH_MAX=251
CONFIG_LOG_DEFAULT_LEVEL=3


###################################################

#
# Copyright (c) 2020 Nordic Semiconductor ASA
#
# SPDX-License-Identifier: LicenseRef-Nordic-5-Clause
#
CONFIG_NCS_SAMPLES_DEFAULTS=y

# Deffered logging helps improve LPN power consumption
# when friendship is established.
CONFIG_LOG_MODE_DEFERRED=y

# General configuration
CONFIG_SYSTEM_WORKQUEUE_STACK_SIZE=2048
CONFIG_FLASH=y
CONFIG_FLASH_MAP=y
CONFIG_NVS=y
CONFIG_NVS_LOOKUP_CACHE=y
CONFIG_SETTINGS=y
CONFIG_SETTINGS_NVS_NAME_CACHE=y
CONFIG_HWINFO=y
CONFIG_DK_LIBRARY=y
CONFIG_PM_SINGLE_IMAGE=y
CONFIG_PM_PARTITION_SIZE_SETTINGS_STORAGE=0x8000
CONFIG_SOC_FLASH_NRF_PARTIAL_ERASE=y

# Temperature sensor
CONFIG_SENSOR=y
CONFIG_TEMP_NRF5=y

# Bluetooth configuration
CONFIG_BT=y
CONFIG_BT_COMPANY_ID=0x0059
#CONFIG_BT_DEVICE_NAME="Mesh Sensor"
#CONFIG_BT_L2CAP_TX_MTU=69
CONFIG_BT_L2CAP_TX_BUF_COUNT=8
#CONFIG_BT_CTLR_DATA_LENGTH_MAX=37
#CONFIG_BT_BUF_ACL_TX_SIZE=37
CONFIG_BT_OBSERVER=y
CONFIG_BT_PERIPHERAL=y
CONFIG_BT_SETTINGS=y

# Disable unused Bluetooth features
CONFIG_BT_CTLR_DUP_FILTER_LEN=0
CONFIG_BT_CTLR_LE_ENC=n
CONFIG_BT_PHY_UPDATE=n
CONFIG_BT_CTLR_CHAN_SEL_2=n
# CONFIG_BT_CTLR_MIN_USED_CHAN=y
CONFIG_BT_CTLR_PRIVACY=n

# Bluetooth mesh configuration
CONFIG_BT_MESH=y
CONFIG_BT_MESH_RELAY=y
CONFIG_BT_MESH_FRIEND=y
CONFIG_BT_MESH_ADV_BUF_COUNT=100
CONFIG_BT_MESH_TX_SEG_MAX=25
CONFIG_BT_MESH_RX_SEG_MAX=25
CONFIG_BT_MESH_PB_GATT=y
CONFIG_BT_MESH_GATT_PROXY=y
CONFIG_BT_MESH_PROXY_USE_DEVICE_NAME=y
CONFIG_BT_MESH_DK_PROV=y
CONFIG_BT_MESH_SUBNET_COUNT=2
CONFIG_BT_MESH_APP_KEY_COUNT=3
CONFIG_BT_MESH_CRPL=32
CONFIG_BT_MESH_MSG_CACHE_SIZE=1000

#CONFIG_BT_MESH_RELAY=y
CONFIG_BT_MESH_RELAY_ENABLED=y 
CONFIG_BT_MESH_RELAY_RETRANSMIT_INTERVAL=30
CONFIG_BT_MESH_RELAY_RETRANSMIT_COUNT=4
CONFIG_BT_MESH_TX_SEG_MSG_COUNT=251
CONFIG_BT_MESH_RX_SEG_MSG_COUNT=251

# Bluetooth mesh models
CONFIG_BT_MESH_SENSOR_SRV=y
CONFIG_BT_MESH_SENSOR_SRV_SENSORS_MAX=5
CONFIG_BT_MESH_SENSOR_LABELS=y
CONFIG_BT_MESH_MODEL_KEY_COUNT=1
CONFIG_BT_MESH_MODEL_GROUP_COUNT=1
CONFIG_BT_MESH_APP_KEY_COUNT=3


CONFIG_ADC=y
CONFIG_ADC_ASYNC=y
CONFIG_GPIO=y
CONFIG_STDOUT_CONSOLE=y
CONFIG_PRINTK=y
CONFIG_PWM=y
CONFIG_LOG_PRINTK=y
CONFIG_LOG_MODE_IMMEDIATE=y
CONFIG_PWM_LOG_LEVEL_DBG=y
CONFIG_NEWLIB_LIBC=y
CONFIG_ADC_NRFX_SAADC=y
CONFIG_NRFX_SAADC=y
CONFIG_LOG=y
CONFIG_PM=y
CONFIG_PM_DEVICE=y
```

## src/main.c
```c
/**
 * @file main.c
 * @brief Main function
 * @date 2023-21-09
 * @author Jeslin
 * @note  This is a test code for pressure sensor.
*/


/*******************************INCLUDES****************************************/
#include <zephyr/device.h>
#include <zephyr/pm/pm.h>
#include <zephyr/pm/device.h>
#include <zephyr/devicetree.h>
#include <zephyr/drivers/gpio.h>
#include <zephyr/kernel.h>
#include <zephyr/sys/printk.h>
#include <zephyr/sys/util.h>
#include <nrfx_example.h>
#include <saadc_examples_common.h>
#include <nrfx_saadc.h>
#include <nrfx_log.h>
#include <stdlib.h>
#include <stdio.h>

//#include "BleHandler.h"
//#include "BleService.h"
#include "JsonHandler.h"
#include "mesh_sub_sys.h"
#include "mesh_handler.h"



/*******************************MACROS****************************************/
#define INFOLITZ_EDIT //Comment this line to disable our changes
//#define SLEEP_ENABLE  //Uncomment this line to enable sleep functionality
#define ADC_MAX_VALUE 1023
#define PRESSURE_SENSOR 0x01

/*******************************TYPEDEFS****************************************/

/*******************************GLOBAL VARIABLES********************************/

#ifndef INFOLITZ_EDIT
    const int pressureMax = 929; //analog reading of pressure transducer at 100psi
    const int pressureZero = 110; //analog reading of pressure transducer at 0psi
#else
    static uint32_t pressureZero = 150; //analog reading of pressure transducer at 0psi
                              //PressureZero = 0.5/3.3V*1024~150(supply voltage - 3.3v) taken from Arduino code refernce from visense 
    static uint32_t pressureMax = 775; //analog reading of pressure transducer at 100psi
                             //PressureMax = 2.5/3.3V*1024~775  taken from Arduino code refernce from visense       
#endif
    uint16_t unPressureRaw = 0;
const int pressuretransducermaxPSI = 70; //psi value of transducer being used
cJSON *pcData = NULL;
const struct device *pAdc = NULL;
const struct gpio_dt_spec sSleepStatusLED = GPIO_DT_SPEC_GET(DT_ALIAS(led0), gpios);
void setPressureZero(uint32_t ucbuff);
void setPressureMax(uint32_t ucbuff);
uint8_t ucAdVertsingBuffer[100] = {0x00, 0x00, 0x00, 0x00, 0x00};
/*******************************FUNCTION DEFINITIONS********************************/

/**
 * @brief  This function is to read raw adc value
 * @param  None 
 * @return uint16_t - ADC result
*/
uint16_t AnalogRead(void)
{
    nrfx_err_t status;
    uint16_t sample_value;

    status = nrfx_saadc_buffer_set(&sample_value, 1);
    NRFX_ASSERT(status == NRFX_SUCCESS);
    status = nrfx_saadc_mode_trigger();
    NRFX_ASSERT(status == NRFX_SUCCESS);

    return sample_value;
}
/**
 * @brief Setting pressureZero
 * @param ucbuffer - buffer for setting pressureZero
 * @return void
*/
void SetPressureZero(uint32_t ucbuffer)
{
    pressureZero = ucbuffer;
}
/**
 * @brief Setting pressureMax
 * @param ucbuffer - buffer for setting pressureMax
 * @return void
*/
void SetPressureMax(uint8_t ucbuffer)
{
    pressureMax = ucbuffer;
}

/*
 * @brief Setting Power management policy
 * @param void
 * @return true or false
*/
static bool SetPMState()
{
    bool bRetVal = false;

    struct pm_state_info info =
    {
        .exit_latency_us  = 0,
        .min_residency_us = 0,
        .state            = PM_STATE_SUSPEND_TO_RAM,
        .substate_id      = 0,
    };

    bRetVal = pm_state_force(0, &info);
    return bRetVal;
}

/**
 * @brief function for entering sleep mode
 * @param nDuration - Duration for sleep
 * @return none
*/
static void EnterSleepMode(int nDuration)
{
    pm_device_action_run(pAdc, PM_DEVICE_ACTION_SUSPEND);
    BleStopAdvertise();
    gpio_pin_set(sSleepStatusLED.port, sSleepStatusLED.pin, 1);
    k_sleep(K_SECONDS(nDuration));
}

/**
 * @brief function for exiting sleep mode
 * @return none
*/
static void ExitSleepMode()
{
    pm_device_action_run(pAdc, PM_DEVICE_ACTION_RESUME);
    gpio_pin_set(sSleepStatusLED.port, sSleepStatusLED.pin, 0);
}

/**
 * @brief function to initialize adc
 * @return void
*/
static void InitADC()
{
    nrfx_err_t status;
    status = nrfx_saadc_init(NRFX_SAADC_DEFAULT_CONFIG_IRQ_PRIORITY);
    NRFX_ASSERT(status == NRFX_SUCCESS);

    nrfx_saadc_channel_t saadc_channel = 
    {
        .channel_config = 
        {
            .resistor_p        = NRF_SAADC_RESISTOR_DISABLED,
            .resistor_n        = NRF_SAADC_RESISTOR_DISABLED,
            .gain              = NRF_SAADC_GAIN1_6,
            .reference         = NRF_SAADC_REFERENCE_VDD4,
            .acq_time          = NRF_SAADC_ACQTIME_10US,
            .mode              = NRF_SAADC_MODE_SINGLE_ENDED,
            .burst             = NRF_SAADC_BURST_DISABLED,
        },
        .pin_p             = NRF_SAADC_INPUT_AIN1,
        .pin_n             = NRF_SAADC_INPUT_DISABLED,
        .channel_index     = 1
    };

    status = nrfx_saadc_channel_config(&saadc_channel);
    NRFX_ASSERT(status == NRFX_SUCCESS);
    
    uint32_t channels_mask = nrfx_saadc_channels_configured_get();
    status = nrfx_saadc_simple_mode_set(channels_mask,
                                        NRF_SAADC_RESOLUTION_10BIT,
                                        NRF_SAADC_OVERSAMPLE_DISABLED,
                                        NULL);
    NRFX_ASSERT(status == NRFX_SUCCESS);
}


/**
 * @brief  Main function
 * @return int
*/
int main(void)
{
    int nError;
    uint16_t unPressureResult =0;
    char cbuffer[30] = {0};
    char *cJsonBuffer= NULL;
    char *pucAdvertisingdata = ucAdVertsingBuffer;
    cJSON *pMainObject = NULL;
    char *pcMeshPayload = NULL;


    SetPMState();
    //pucAdvertisingdata = GetAdvertisingBuffer();
    InitADC();
    k_sleep(K_MSEC(100));
    pAdc = device_get_binding("arduino_adc");

     if (!EnableBLE())
     {
         //printk("Bluetooth init failed (err %d)\n", nError);
         return 0;
     }
/*
    nError = InitExtendedAdv();
	if (nError) 
    {
		printk("Advertising failed to create (err %d)\n", nError);
		return 0;
	}
*/
    sprintf(cbuffer,"%dpsi", unPressureResult);
    //StartAdvertising();
    gpio_pin_configure_dt(&sSleepStatusLED, GPIO_ACTIVE_LOW);
    int32_t x = 10;
    //startPub(x);
    // startPub(x);

    while (1) 
    {
        
        unPressureRaw = AnalogRead();
        //startPub(unPressureRaw);
        if (unPressureRaw > ADC_MAX_VALUE)
        {
            unPressureRaw = 0;
        }
        printk("ADCRaw: %d\n", unPressureRaw);
        pMainObject = cJSON_CreateObject();
        AddItemtoJsonObject(&pMainObject, NUMBER, "ADCValue", &unPressureRaw, sizeof(uint16_t));
        if (unPressureRaw > pressureZero && unPressureRaw < ADC_MAX_VALUE)
        {
            memset(cbuffer, '\0',sizeof(cbuffer));
            unPressureResult = ((unPressureRaw-pressureZero)*pressuretransducermaxPSI)/(pressureMax-pressureZero);
            
            sprintf(cbuffer,"%dpsi", unPressureResult);
            printk("Data:%s\n", cbuffer);
            AddItemtoJsonObject(&pMainObject, STRING, "CurrPressure", (uint8_t*)cbuffer, (uint8_t)strlen(cbuffer));

        }
        else
        {
             AddItemtoJsonObject(&pMainObject, STRING, "PrevPressure", (uint8_t*)cbuffer, (uint8_t)strlen(cbuffer));   
        }
        //strcpy(cJsonBuffer, "0");
        //strcpy(cJsonBuffer, "1");
        cJsonBuffer = cJSON_Print(pMainObject);
      //  strcat(cJsonBuffer, (char *)cJSON_Print(pMainObject));
         SetMeshPayload(cJsonBuffer);
         //memcpy(pcMeshPayload, cJsonBuffer, strlen(cJsonBuffer));

        pucAdvertisingdata[2] = PRESSURE_SENSOR;
        pucAdvertisingdata[3] = (uint8_t)strlen(cJsonBuffer);
        memcpy(&pucAdvertisingdata[4], cJsonBuffer, strlen(cJsonBuffer));
        printk("JSON:\n%s\n", cJsonBuffer);
        // meshPayloadSend(cJsonBuffer);
        // pucAdvertisingdata[0] = 0x01;
        // pucAdvertisingdata[1] = 0x02;
        // startPub(cJsonBuffer);
        //struct sensor_value *value = (struct sensor_value *)pucAdvertisingdata;
        
        
        
/*
        if(IsNotificationenabled())
        {
           //VisenseSensordataNotify(pucAdvertisingdata+2, ADV_BUFF_SIZE);
        }
        else if (!IsNotificationenabled() && !IsConnected())
        {
            //UpdateAdvertiseData();
            //StartAdvertising();
        }
        else
        {
            //NO OP
        }
        
        //memset(pucAdvertisingdata, 0, ADV_BUFF_SIZE);
*/
        cJSON_Delete(pMainObject);
        cJSON_free(cJsonBuffer);
        k_sleep(K_MSEC(1500));
        printk("PressureZero: %d\n", pressureZero);
        printk("PressureMax: %d\n", pressureMax);
        #ifdef SLEEP_ENABLE
         EnterSleepMode(180);
         ExitSleepMode();
        #endif
    }
}
```
