## nRFPressureSensorCode/build_4/Kconfig/Kconfig.shield
```kconfig
osource "c:/users/rajee/downloads/nrf52-sensors-feature_timestamp/nrf52-sensors-feature_timestamp/nrfpressuresensorcode/boards/shields/*/Kconfig.shield"
osource "C:/zephyr/v2.4.2/nrf/boards/shields/*/Kconfig.shield"
```

## nRFPressureSensorCode/build_4/Kconfig/Kconfig.shield.defconfig
```kconfig
osource "c:/users/rajee/downloads/nrf52-sensors-feature_timestamp/nrf52-sensors-feature_timestamp/nrfpressuresensorcode/boards/shields/*/Kconfig.defconfig"
osource "C:/zephyr/v2.4.2/nrf/boards/shields/*/Kconfig.defconfig"
```
