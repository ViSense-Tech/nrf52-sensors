# 2805x_Analog_Subsystem_Registers register map
Vendor: Texas Instruments
Peripheral module from a debugger description file (folder C2000).
Address unit: 16 bits
Registers are 16-bit, access not given, no defined reset value unless marked. A register's access mark holds for its fields unless they carry their own. Offsets are as the file gives them; lines under a group give offsets from that group; [hi:lo] are bit positions; {n}, {i} and the like mark numbered series; 'fields as' and 'values as' point back to an identical list; <NAME> marks a mode.

## ANALOG_SUBSYS_REGS — ANALOG SUBSYS REGS Registers
0x00 DAC1CTL — DAC1 control
0x01 DAC2CTL — DAC2 control
0x02 DAC3CTL — DAC3 control
0x03 DAC4CTL — DAC4 control
0x04 DAC5CTL — DAC5 control
0x05 VREFOUTCTL — VREFOUT (DAC6) control
0x10 DACEN — DAC Enables
0x11 VREFOUTEN — VREFOUT Enable
0x12 PGAEN — Programmable Gain Amplifier Enable
0x13 COMPEN — Comparator Enable
0x14 AMPM1_GAIN — Motor Unit 1 PGA Gain controls
0x15 AMPM2_GAIN — Motor Unit 2 PGA Gain controls
0x16 AMPPFC_GAIN — PFC PGA Gain controls
0x21 ADCINSWITCH — ADC input-select switch control
0x29 COMPHYSTCTL — Comparator High AND Low hysteresis enable/disable
0x30 CTRIPA1ICTL — CTRIPA1 Filter Input and function Control
0x31 CTRIPA1FILCTL — CTRIPA1 Filter parameters
0x32 CTRIPA1FILCLKCTL — CTRIPA1 Filter Sample Clock Control
0x34 CTRIPA3ICTL — CTRIPA3 Filter Input and function Control
0x35 CTRIPA3FILCTL — CTRIPA3 Filter parameters
0x36 CTRIPA3FILCLKCTL — CTRIPA3 Filter Sample Clock Control
0x38 CTRIPB1ICTL — CTRIPB1 Filter Input and function Control
0x39 CTRIPB1FILCTL — CTRIPB1 Filter parameters
0x3A CTRIPB1FILCLKCTL — CTRIPB1 Filter Sample Clock Control
0x3D CTRIPM1OCTL — CTRIPM1 CTRIP Filter Output Control
0x3E CTRIPM1STS — CTRIPM1 CTRIPx outputs status
0x3F CTRIPM1FLGCLR — CTRIPM1 CTRIPx flag clear
0x50 CTRIPA6ICTL — CTRIPA6 Filter Input and function Control
0x51 CTRIPA6FILCTL — CTRIPA6 Filter parameters
0x52 CTRIPA6FILCLKCTL — CTRIPA6 Filter Sample Clock Control
0x54 CTRIPB4ICTL — CTRIPB4 Filter Input and function Control
0x55 CTRIPB4FILCTL — CTRIPB4 Filter parameters
0x56 CTRIPB4FILCLKCTL — CTRIPB4 Filter Sample Clock Control
0x58 CTRIPB6ICTL — CTRIPB6 Filter Input and function Control
0x59 CTRIPB6FILCTL — CTRIPB6 Filter parameters
0x5A CTRIPB6FILCLKCTL — CTRIPB6 Filter Sample Clock Control
0x5D CTRIPM2OCTL — CTRIPM2 CTRIP Filter Output Control
0x5E CTRIPM2STS — CTRIPM2 CTRIPx outputs status
0x5F CTRIPM2FLGCLR — CTRIPM2 CTRIPx flag clear
0x70 CTRIPB7ICTL — CTRIPB7 Filter Input and function Control
0x71 CTRIPB7FILCTL — CTRIPB7 Filter parameters
0x72 CTRIPB7FILCLKCTL — CTRIPB7 Filter Sample Clock Control
0x7D CTRIPPFCOCTL — CTRIPPFC CTRIPx outputs status
0x7E CTRIPPFCSTS — CTRIPPFC CTRIPx flag clear
0x7F CTRIPPFCFLGCLR — CTRIPPFC COMP Test Control
0xF0 LOCKCTRIP — Lock Register for CTRIP Filters
0xF2 LOCKDAC — Lock Register for DACs
0xF4 LOCKAMPCOMP — Lock Register for Amplifiers and Comparators
0xF6 LOCKSWITCH — Lock Register for Switches
