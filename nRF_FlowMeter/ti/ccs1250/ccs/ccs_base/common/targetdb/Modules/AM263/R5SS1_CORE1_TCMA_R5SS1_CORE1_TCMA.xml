# R5SS1_CORE1_TCMA_R5SS1_CORE1_TCMA register map
Vendor: Texas Instruments
Peripheral module from a debugger description file (folder AM263).
Registers are 32-bit, read-write, reset 0x0 unless marked. A register's access mark holds for its fields unless they carry their own. Offsets are as the file gives them; lines under a group give offsets from that group; [hi:lo] are bit positions; {n}, {i} and the like mark numbered series; 'fields as' and 'values as' point back to an identical list; <NAME> marks a mode.

## R5SS1_CORE1_TCMA_R5SS1_CORE1_TCMA
0x00 R5SS1_CORE1_TCMA_START
  [31:0] START — TCMA start address
0x7FFC R5SS1_CORE1_TCMA_END
  [31:0] END — TCMA end address
