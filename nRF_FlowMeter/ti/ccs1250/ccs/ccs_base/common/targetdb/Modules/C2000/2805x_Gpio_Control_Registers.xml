# 2805x_Gpio_Control_Registers register map
Vendor: Texas Instruments
Peripheral module from a debugger description file (folder C2000).
Address unit: 16 bits
Registers are 32-bit, access not given, no defined reset value unless marked. A register's access mark holds for its fields unless they carry their own. Offsets are as the file gives them; lines under a group give offsets from that group; [hi:lo] are bit positions; {n}, {i} and the like mark numbered series; 'fields as' and 'values as' point back to an identical list; <NAME> marks a mode.

## GPIO_CTRL_REGS — GPIO CTRL REGS Registers
0x00 GPACTRL — GPIO A Control Register (GPIO0 to 31)
0x02 GPAQSEL1 — GPIO A Qualifier Select 1 Register (GPIO0 to 15)
0x04 GPAQSEL2 — GPIO A Qualifier Select 2 Register (GPIO16 to 31)
0x06 GPAMUX1 — GPIO A Mux 1 Register (GPIO0 to 15)
0x08 GPAMUX2 — GPIO A Mux 2 Register (GPIO16 to 31)
0x0A GPADIR — GPIO A Direction Register (GPIO0 to 31) )
0x0C GPAPUD — GPIO A Pull-Up Disable Register
0x10 GPBCTRL — GPIO B Control Register (GPIO32 to 44)
0x12 GPBQSEL1 — GPIO B Qualifier Select 1 Register (GPIO32 to 44)
0x16 GPBMUX1 — GPIO B Mux 1 Register (GPIO32 to 44)
0x1A GPBDIR — GPIO B Direction Register (GPIO32 to 44)
0x1C GPBPUD — GPIO B Pull-Up Disable Register
