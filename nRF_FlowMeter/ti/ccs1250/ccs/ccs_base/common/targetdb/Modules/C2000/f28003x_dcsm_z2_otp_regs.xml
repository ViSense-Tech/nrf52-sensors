# f28003x_dcsm_z2_otp_regs register map
Vendor: Texas Instruments
Peripheral module from a debugger description file (folder C2000).
Address unit: 16 bits
Registers are 32-bit, read-only, no defined reset value unless marked. A register's access mark holds for its fields unless they carry their own. Offsets are as the file gives them; lines under a group give offsets from that group; [hi:lo] are bit positions; {n}, {i} and the like mark numbered series; 'fields as' and 'values as' point back to an identical list; <NAME> marks a mode.

## DCSM_Z2_OTP — DCSM Z2 OTP Registers
0x00 Z2OTP_LINKPOINTER1 — Zone 2 Link Pointer1
  [31:0] Z2OTP_LINKPOINTER1 — Zone2 Link Pointer 1 location in USER OTP.
0x02 Z2OTP_LINKPOINTER2 — Zone 2 Link Pointer2
  [31:0] Z2OTP_LINKPOINTER2 — Zone2 Link Pointer 2 location in USER OTP.
0x04 Z2OTP_LINKPOINTER3 — Zone 2 Link Pointer3
  [31:0] Z2OTP_LINKPOINTER3 — Zone2 Link Pointer 3 location in USER OTP.
{0x6+2i} Z2OTP_GPREG{i} (i=1..4) — Zone 2 General Purpose Register {i}
  [31:0] Z2OTP_GPREG{i} — Zone2 General Purpose register location in USER OTP.
0x10 Z2OTP_PSWDLOCK — Secure Password Lock
  [31:0] Z2OTP_PSWDLOCK — Zone2 Password lock location in USER OTP.
0x12 Z2OTP_CRCLOCK — Secure CRC Lock
  [31:0] Z2OTP_CRCLOCK — Zone2 CRC lock location in USER OTP.
