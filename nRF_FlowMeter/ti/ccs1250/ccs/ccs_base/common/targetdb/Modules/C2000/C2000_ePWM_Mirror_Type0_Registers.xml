# C2000_ePWM_Mirror_Type0_Registers register map
Vendor: Texas Instruments
Peripheral module from a debugger description file (folder C2000).
Address unit: 16 bits
Registers are 16-bit, access not given, no defined reset value unless marked. A register's access mark holds for its fields unless they carry their own. Offsets are as the file gives them; lines under a group give offsets from that group; [hi:lo] are bit positions; {n}, {i} and the like mark numbered series; 'fields as' and 'values as' point back to an identical list; <NAME> marks a mode.

## EWM_MIRROR — ePWM Control and Status Registers
0x00 TBCTL — ePWM Time Base Control Register
0x01 TBSTS — ePWM Time Base Status Register
0x02 TBPHSHR — ePWM Time Base Phase HRPWM Register
0x03 TBPHS — ePWM Time Base Phase Register
0x04 TBCTR — ePWM Time Base Counter Register
0x05 TBPRD — ePWM Time Base Period Register Set
0x07 CMPCTL — ePWM Counter Compare Control Register
0x08 CMPAHR — ePWM Time Base Compare A HRPWM Register
0x09 CMPA — ePWM Counter Compare A Register Set
0x0A CMPB — ePWM Counter Compare B Register Set
0x0B AQCTLA — ePWM Action Qualifier Control Register For Output A
0x0C AQCTLB — ePWM Action Qualifier Control Register For Output B
0x0D AQSFRC — ePWM Action Qualifier Software Force Register
0x0E AQCSFRC — ePWM Action Qualifier Continuous S/W Force Register Set
0x0F DBCTL — ePWM Dead-Band Generator Control Register
0x10 DBRED — ePWM Dead-Band Generator Rising Edge Delay Count Register
0x11 DBFED — ePWM Dead-Band Generator Falling Edge Delay Count Register
0x12 TZSEL — ePWM Trip Zone Select Register
0x14 TZCTL — ePWM Trip Zone Control Register
0x15 TZEINT — ePWM Trip Zone Enable Interrupt Register
0x16 TZFLG — ePWM Trip Zone Flag Register
0x17 TZCLR — ePWM Trip Zone Clear Register
0x18 TZFRC — ePWM Trip Zone Force Register
0x19 ETSEL — ePWM Event Trigger Selection Register
0x1A ETPS — ePWM Event Trigger Prescale Register
0x1B ETFLG — ePWM Event Trigger Flag Register
0x1C ETCLR — ePWM Event Trigger Clear Register
0x1D ETFRC — ePWM Event Trigger Force Register
0x1E PCCTL — ePWM PWM Chopper Control Register
0x20 HRCNFG — ePWM HRPWM Configuration Register
