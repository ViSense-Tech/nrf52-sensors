# cslr_pwrdwnPdc register map
Vendor: Texas Instruments
Peripheral module from a debugger description file (folder TCI6484_C6457).
Registers are 32-bit, access not given, reset 0xFFFF unless marked. A register's access mark holds for its fields unless they carry their own. Offsets are as the file gives them; lines under a group give offsets from that group; [hi:lo] are bit positions; {n}, {i} and the like mark numbered series; 'fields as' and 'values as' point back to an identical list; <NAME> marks a mode.

## PDC — Power Down
0x00 PDCCMD — Power Down Control Command Register
  [16] MEGPD rw — Power Down during Idle 0 - Normal operation. Do not power-down CPU or C64x+ megamodule when CPU is IDLE 1  Sleep mode. Power-down CPU and C64x+ megamodule when CPU enters IDLE state
    0=NORMAL (Normal operation); 1=SLEEP (Sleep mode)
