# STATS register map
Vendor: Texas Instruments
Peripheral module from a debugger description file (folder DRA74xP_75xP_76xP_77xP).
Registers are 32-bit, read-write, reset 0x0 unless marked. A register's access mark holds for its fields unless they carry their own. Offsets are as the file gives them; lines under a group give offsets from that group; [hi:lo] are bit positions; {n}, {i} and the like mark numbered series; 'fields as' and 'values as' point back to an identical list; <NAME> marks a mode.

## STATS
0x00 GOOD_RX_FRAMES — The total number of good frames received on the port. A good frame is defined to be: - Any data or MAC control frame which matched a unicast, broadcast or multicast address, or matched due to promiscuous mode - Had a length of 64 to [13:0] RX_MAXLEN bytes inclusive - Had no CRC error, alignment error or code error. See the and statistic descriptions for definitions of alignment, code and CRC errors. Overruns have no effect upon this statistic.
  [31:0] VALUE — Statistic value
0x04 BROADCAST_RX_FRAMES — The total number of good broadcast frames received on the port. A good broadcast frame is defined to be: - Any data or MAC control frame which was destined for only address 0xFFFFFFFFFFFF - Had a length of [13:0] RX_MAXLEN bytes inclusive - Had no CRC error, alignment error or code error. See the and statistic descriptions for definitions of alignment, code and CRC errors. Overruns have no effect upon this statistic.
  [31:0] VALUE — Statistic value
0x08 MULTICAST_RX_FRAMES — The total number of good multicast frames received on the port. A good multicast frame is defined to be: - Any data or MAC control frame which was destined for any multicast address other than 0xFFFFFFFFFFFF - Had a length of [13:0] RX_MAXLEN bytes inclusive - Had no CRC error, alignment error or code error. See the and statistic descriptions for definitions of alignment, code and CRC errors. Overruns have no effect upon this statistic.
  [31:0] VALUE — Statistic value
0x0C PAUSE_RX_FRAMES — The total number of IEEE 802.3X pause frames received by the port (whether acted upon or not). Such a frame: - Contained any unicast, broadcast, or multicast address - Contained the length/type field value 88.08 (hex) and the opcode 0x0001 - Was of length 64 to [13:0] RX_MAXLEN bytes inclusive - Had no CRC error, alignment error or code error - Pause-frames had been enabled on the port ([4] TX_FLOW_EN = 1). The port could have been in either half or full-duplex mode. See the and statistic descriptions for definitions of alignment, code and CRC errors. Overruns have no effect upon this statistic.
  [31:0] VALUE — Statistic value
0x10 RX_CRC_ERRORS — The total number of frames received on the port that experienced a CRC error. Such a frame: - Was any data or MAC control frame which matched a unicast, broadcast or multicast address, or matched due to promiscuous mode - Was of length 64 to [13:0] RX_MAXLEN bytes inclusive - Had no code/align error, - Had a CRC error Overruns have no effect upon this statistic. A CRC error is defined to be: - A frame containing an even number of nibbles - Failing the Frame Check Sequence test
  [31:0] VALUE — Statistic value
0x14 RX_ALIGN_CODE_ERRORS — The total number of frames received on the port that experienced an alignment error or code error. Such a frame: - Was any data or MAC control frame which matched a unicast, broadcast or multicast address, or matched due to promiscuous mode - Was of length 64 to [13:0] RX_MAXLEN bytes inclusive - Had either an alignment error or a code error Overruns have no effect upon this statistic. An alignment error is defined to be: - A frame containing an odd number of nibbles - Failing the Frame Check Sequence test if the final nibble is ignored A code error is defined to be a frame which has been discarded because the port's MRXER pin driven with a one for at least one bit-time's duration at any point during the frame's reception. Note: RFC 1757 etherStatsCRCAlignErrors Ref. 1.5 can be calculated by summing and .
  [31:0] VALUE — Statistic value
0x18 OVERSIZE_RX_FRAMES — The total number of oversized frames received on the port. An oversized frame is defined to be: - Was any data or MAC control frame which matched a unicast, broadcast or multicast address, or matched due to promiscuous mode - Was greater than [13:0] RX_MAXLEN in bytes - Had no CRC error, alignment error or code error See the and statistic descriptions for definitions of alignment, code and CRC errors. Overruns have no effect upon this statistic.
  [31:0] VALUE — Statistic value
0x1C RX_JABBERS — The total number of jabber frames received on the port. A jabber frame: - Was any data or MAC control frame which matched a unicast, broadcast or multicast address, or matched due to promiscuous mode - Was greater than [13:0] RX_MAXLEN in bytes - Had no CRC error, alignment error or code error See the and statistic descriptions for definitions of alignment, code and CRC errors. Overruns have no effect upon this statistic.
  [31:0] VALUE — Statistic value
0x20 UNDERSIZE_RX_FRAMES — The total number of undersized frames received on the port. An undersized frame is defined to be: - Was any data frame which matched a unicast, broadcast or multicast address, or matched due to promiscuous mode - Was greater than [13:0] RX_MAXLEN in bytes - Had no CRC error, alignment error or code error See the and statistic descriptions for definitions of alignment, code and CRC errors. Overruns have no effect upon this statistic.
  [31:0] VALUE — Statistic value
0x24 RX_FRAGMENTS — The total number of frame fragments received on the port. A frame fragment is defined to be: - Any data frame (address matching does not matter) - Less than 64 bytes long - Having a CRC error, an alignment error, or a code error - Not the result of a collision caused by half duplex, collision based flow control See the and statistic descriptions for definitions of alignment, code and CRC errors. Overruns have no effect upon this statistic.
  [31:0] VALUE — Statistic value
0x30 RX_OCTETS — The total number of bytes in all good frames received on the port. A good frame is defined to be: - Any data or MAC control frame which matched a unicast, broadcast or multicast address, or matched due to promiscuous mode - Of length 64 to [13:0] RX_MAXLEN bytes inclusive - Had no CRC error, alignment error or code error See the and statistic descriptions for definitions of alignment, code and CRC errors. Overruns have no effect upon this statistic.
  [31:0] VALUE — Statistic value
0x34 GOOD_TX_FRAMES — The total number of good frames received on the port. A good frame is defined to be: - Any data or MAC control frame which matched a unicast, broadcast or multicast address, or matched due to promiscuous mode - Any length - Had no late or excessive collisions, no carrier loss and no underrun
  [31:0] VALUE — Statistic value
0x38 BROADCAST_TX_FRAMES — The total number of good broadcast frames received on the port. A good broadcast frame is defined to be: - Any data or MAC control frame which was destined for only address 0xFFFFFFFFFFFF - Any length - Had no late or excessive collisions, no carrier loss and no underrun
  [31:0] VALUE — Statistic value
0x3C MULTICAST_TX_FRAMES — The total number of good multicast frames received on the port. A good multicast frame is defined to be: - Any data or MAC control frame which was destined for any multicast address other than 0xFFFFFFFFFFFF - Any length - Had no late or excessive collisions, no carrier loss and no underrun
  [31:0] VALUE — Statistic value
0x40 PAUSE_TX_FRAMES — This statistic indicates the number of IEEE 802.3X pause frames transmitted by the port. Pause frames cannot underrun or contain a CRC error because they are created in the transmitting MAC, so these error conditions have no effect upon the statistic. Pause frames sent by software will not be included in this count. Since pause frames are only transmitted in full duplex carrier loss and collisions have no effect upon this statistic. Transmitted pause frames are always 64 byte multicast frames so will appear in the and statistics.
  [31:0] VALUE — Statistic value
0x44 DEFERRED_TX_FRAMES — The total number of frames transmitted on the port that first experienced deferment. Such a frame: - Was any data or MAC control frame destined for any unicast, broadcast or multicast address - Was any size - Had no carrier loss and no underrun - Experienced no collisions before being successfully transmitted - Found the medium busy when transmission was first attempted, so had to wait. CRC errors have no effect upon this statistic.
  [31:0] VALUE — Statistic value
0x48 COLLISIONS — This statistic records the total number of times that the port experienced a collision. Collisions occur under two circumstances. 1. When a transmit data or MAC control frame: - Was destined for any unicast, broadcast or multicast address - Was any size - Had no carrier loss and no underrun - Experienced a collision. A jam sequence is sent for every non-late collision, so this statistic will increment on each occasion if a frame experiences multiple collisions (and increments on late collisions) CRC errors have no effect upon this statistic. 2. When the port is in half-duplex mode, flow control is active, and a frame reception begins.
  [31:0] VALUE — Statistic value
0x4C SINGLE_COLLISION_TX_FRAMES — The total number of frames transmitted on the port that experienced exactly one collision. Such a frame: - Was any data or MAC control frame destined for any unicast, broadcast or multicast address - Was any size - Had no carrier loss and no underrun - Experienced one collision before successful transmission. The collision was not late. CRC errors have no effect upon this statistic.
  [31:0] VALUE — Statistic value
0x50 MULTIPLE_COLLISION_TX_FRAMES — The total number of frames transmitted on the port that experienced multiple collisions. Such a frame: - Was any data or MAC control frame destined for any unicast, broadcast or multicast address - Was any size - Had no carrier loss and no underrun - Experienced 2 to 15 collisions before being successfully transmitted. None of the collisions were late. CRC errors have no effect upon this statistic.
  [31:0] VALUE — Statistic value
0x54 EXCESSIVE_COLLISIONS — The total number of frames for which transmission was abandoned due to excessive collisions. Such a frame: - Was any data or MAC control frame destined for any unicast, broadcast or multicast address - Was any size - Had no carrier loss and no underrun - Experienced 16 collisions before abandoning all attempts at transmitting the frame. None of the collisions were late. CRC errors have no effect upon this statistic.
  [31:0] VALUE — Statistic value
0x58 LATE_COLLISIONS — The total number of frames on the port for which transmission was abandoned because they experienced a late collision. Such a frame: - Was any data or MAC control frame destined for any unicast, broadcast or multicast address - Was any size - Experienced a collision later than 512 bit-times into the transmission. There may have been up to 15 previous (non-late) collisions which had previously required the transmission to be re-attempted. The Late Collisions statistic dominates over the single, multiple and excessive Collisions statistics - if a late collision occurs the frame will not be counted in any of these other three statistics. CRC errors have no effect upon this statistic.
  [31:0] VALUE — Statistic value
0x5C TX_UNDERRUN — There should be no transmitted frames that experience underrun.
  [31:0] VALUE — Statistic value
0x60 CARRIER_SENSE_ERRORS — The total number of frames received on the port that had a CPDMA middle of frame (MOF) overrun. MOF overrun frame is defined to be: - Was any data or MAC control frame destined for any unicast, broadcast or multicast address - Was any size - The carrier sense condition was lost or never asserted when transmitting the frame (the frame is not retransmitted). This is a transmit only statistic. Carrier Sense is a don't care for received frames. Transmit frames with carrier sense errors are sent until completion and are not aborted. CRC errors have no effect upon this statistic.
  [31:0] VALUE — Statistic value
0x64 TX_OCTETS — The total number of bytes in all good frames transmitted on the port. A good frame is defined to be: - Any data or MAC control frame which was destined for any unicast, broadcast or multicast address - Was any size - Had no late or excessive collisions, no carrier loss and no underrun.
  [31:0] VALUE — Statistic value
0x68 RX_TX_64_OCTET_FRAMES — The total number of 64-byte frames received and transmitted on the port. Such a frame is defined to be: - Any data or MAC control frame which was destined for any unicast, broadcast or multicast address - Did not experience late collisions, excessive collisions, or carrier sense error - Was exactly 64 bytes long. (If the frame was being transmitted and experienced carrier loss that resulted in a frame of this size being transmitted, then the frame will be recorded in this statistic). CRC errors, code/align errors and overruns do not affect the recording of frames in this statistic.
  [31:0] VALUE — Statistic value
0x6C RX_TX_65_127_OCTET_FRAMES — The total number of frames of size 65 to 127 bytes received and transmitted on the port. Such a frame is defined to be: - Any data or MAC control frame which was destined for any unicast, broadcast or multicast address - Did not experience late collisions, excessive collisions, or carrier sense error - Was 65 to 127 bytes long CRC errors, code/align errors, underruns and overruns do not affect the recording of frames in this statistic.
  [31:0] VALUE — Statistic value
0x70 RX_TX_128_255_OCTET_FRAMES — The total number of frames of size 128 to 255 bytes received and transmitted on the port. Such a frame is defined to be: - Any data or MAC control frame which was destined for any unicast, broadcast or multicast address - Did not experience late collisions, excessive collisions, or carrier sense error - Was 128 to 255 bytes long CRC errors, code/align errors, underruns and overruns do not affect the recording of frames in this statistic.
  [31:0] VALUE — Statistic value
0x74 RX_TX_256_511_OCTET_FRAMES — The total number of frames of size 256 to 511 bytes received and transmitted on the port. Such a frame is defined to be: - Any data or MAC control frame which was destined for any unicast, broadcast or multicast address - Did not experience late collisions, excessive collisions, or carrier sense error - Was 256 to 511 bytes long CRC errors, code/align errors, underruns and overruns do not affect the recording of frames in this statistic.
  [31:0] VALUE — Statistic value
0x78 RX_TX_512_1023_OCTET_FRAMES — The total number of frames of size 512 to 1023 bytes received and transmitted on the port. Such a frame is defined to be: - Any data or MAC control frame which was destined for any unicast, broadcast or multicast address - Did not experience late collisions, excessive collisions, or carrier sense error - Was 512 to 1023 bytes long CRC errors, code/align errors, underruns and overruns do not affect the recording of frames in this statistic.
  [31:0] VALUE — Statistic value
0x7C RX_TX_1024_UP_OCTET_FRAMES — The total number of frames of size 1024 to[13:0] RX_MAXLEN bytes for receive or 1024 up for transmit on the port. Such a frame is defined to be: - Any data or MAC control frame which was destined for any unicast, broadcast or multicast address - Did not experience late collisions, excessive collisions, or carrier sense error - Was 1024 to [13:0] RX_MAXLEN bytes long on receive, or any size on transmit CRC errors, code/align errors, underruns and overruns do not affect the recording of frames in this statistic.
  [31:0] VALUE — Statistic value
0x80 NET_OCTETS — The total number of bytes of frame data received and transmitted on the port. Each frame counted: - was any data or MAC control frame destined for any unicast, broadcast or multicast address (address match does not matter) - Any length (including less than 64 bytes and greater than [13:0] RX_MAXLEN bytes) Also counted in this statistic is: - Every byte transmitted before a carrier- loss was experienced - Every byte transmitted before each collision was experienced, (i.e. multiple retries are counted each time) - Every byte received if the port is in half-duplex mode until a jam sequence was transmitted to initiate flow control. (The jam sequence was not counted to prevent double-counting) Error conditions such as alignment errors, CRC errors, code errors, overruns and underruns do not affect the recording of bytes by this statistic. The objective of this statistic is to give a reasonable indication of ethernet utilization
  [31:0] VALUE — Statistic value
0x84 RX_START_OF_FRAME_OVERRUNS — The total number of frames received on the port that had a CPDMA start of frame (SOF) overrun or were dropped by due to FIFO resource limitations, or were dropped by the SPF. SOF overrun frame is defined to be: - Any data or MAC control frame which matched a unicast, broadcast or multicast address, or matched due to promiscuous mode - Any length (including less than 64 bytes and greater than [13:0] RX_MAXLEN bytes) - The CPDMA had a start of frame overrun or the packet was dropped due to FIFO resource limitations
  [31:0] VALUE — Statistic value
0x88 RX_MIDDLE_OF_FRAME_OVERRUNS — The total number of frames received on the port that had a CPDMA middle of frame (MOF) overrun. MOF overrun frame is defined to be: - Any data or MAC control frame which matched a unicast, broadcast or multicast address, or matched due to promiscuous mode - Any length (including less than 64 bytes and greater than [13:0] RX_MAXLEN bytes) - The CPDMA had a middle of frame overrun
  [31:0] VALUE — Statistic value
0x8C RX_DMA_OVERRUNS — The total number of frames received on the port that had either a DMA start of frame (SOF) overrun or a DMA MOF overrun. An Rx DMA overrun frame is defined to be: - Any data or MAC control frame which matched a unicast, broadcast or multicast address, or matched due to promiscuous mode - Any length (including less than 64 bytes and greater than [13:0] RX_MAXLEN bytes) - The CPGMAC_SL was unable to receive it because it did not have the DMA buffer resources to receive it (zero head descriptor pointer at the start or during the middle of the frame reception) CRC errors, alignment errors and code errors have no effect upon this statistic.
  [31:0] VALUE — Statistic value
