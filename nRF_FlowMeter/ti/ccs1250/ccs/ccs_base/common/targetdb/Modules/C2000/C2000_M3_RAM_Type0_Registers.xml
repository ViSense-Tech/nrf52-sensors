# C2000_M3_RAM_Type0_Registers register map
Vendor: Texas Instruments
Peripheral module from a debugger description file (folder C2000).
Address unit: 16 bits
Registers are 32-bit, access not given, no defined reset value unless marked. A register's access mark holds for its fields unless they carry their own. Offsets are as the file gives them; lines under a group give offsets from that group; [hi:lo] are bit positions; {n}, {i} and the like mark numbered series; 'fields as' and 'values as' point back to an identical list; <NAME> marks a mode.

## RAM_CONFIG_REGS — RAM CONFIG REGS Registers
0x00 CXDRCR1 — Cx DEDRAM Config Register 1
0x08 CXSRCR1 — Cx SHRAM Config Register 1
0x10 MSXMSEL — Sx SHRAM Master Select Register
0x14 MSXSRCR1 — M3 Sx SHRAM Config Register 1
0x18 MSXSRCR2 — M3 Sx SHRAM Config Register 2
0x24 MTOCMSGRCR — M3TOC28_MSG_RAM Config Register
0x34 CXRTESTINIT1 — Cx RAM_TEST and INIT Register 1
0x44 MSXRTESTINIT1 — M3 Sx RAM_TEST and INIT Register 1
0x54 MTOCRTESTINIT — M3 To Cx Message TEST and INIT Register
0x64 CXRINITDONE1 — Cx RAM_ INIT_DONE Register 1
0x6C MSXRINITDONE1 — M3 Sx RAM_INIT_DONE Register
0x7C MTOCRINITDONE — M3 To Cx Message RAM Init Done
