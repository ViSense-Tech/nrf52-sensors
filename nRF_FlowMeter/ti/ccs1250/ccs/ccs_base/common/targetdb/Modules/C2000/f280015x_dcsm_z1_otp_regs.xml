# f280015x_dcsm_z1_otp_regs register map
Vendor: Texas Instruments
Peripheral module from a debugger description file (folder C2000).
Address unit: 16 bits
Registers are 32-bit, read-only, no defined reset value unless marked. A register's access mark holds for its fields unless they carry their own. Offsets are as the file gives them; lines under a group give offsets from that group; [hi:lo] are bit positions; {n}, {i} and the like mark numbered series; 'fields as' and 'values as' point back to an identical list; <NAME> marks a mode.

## DCSM_Z1_OTP — DCSM Z1 OTP Registers
0x00 Z1OTP_LINKPOINTER1 — Zone 1 Link Pointer1
  [31:0] Z1OTP_LINKPOINTER1 — Zone1 Link Pointer 1 location in USER OTP.
0x02 Z1OTP_LINKPOINTER2 — Zone 1 Link Pointer2
  [31:0] Z1OTP_LINKPOINTER2 — Zone1 Link Pointer 2 location in USER OTP.
0x04 Z1OTP_LINKPOINTER3 — Zone 1 Link Pointer3
  [31:0] Z1OTP_LINKPOINTER3 — Zone1 Link Pointer 3 location in USER OTP.
0x06 Z1OTP_JLM_ENABLE — Zone 1 JTAGLOCK Enable Register
  [31:0] Z1OTP_JLM_ENABLE — Zone1 JLM_ENABLE location in USER OTP.
{0x6+2i} Z1OTP_GPREG{i} (i=1..4) — Zone 1 General Purpose Register {i}
  [31:0] Z1OTP_GPREG{i} — Zone1 General Purpose register location in USER OTP.
0x10 Z1OTP_PSWDLOCK — Secure Password Lock
  [31:0] Z1OTP_PSWDLOCK — Zone1 Password lock location in USER OTP.
0x12 Z1OTP_CRCLOCK — Secure CRC Lock
  [31:0] Z1OTP_CRCLOCK — Zone1 CRC lock location in USER OTP.
0x14 Z1OTP_JTAGPSWDH0 — JTAG Lock Permanent Password 0
  [31:0] JTAGPSWDH0 — JTAG Lock Password High 0 location in USER Z1 OTP.
0x16 Z1OTP_JTAGPSWDH1 — JTAG Lock Permanent Password 1
  [31:0] JTAGPSWDH1 — JTAG Lock Password High 1 location in USER Z1 OTP.
{0x18+2i} Z1OTP_CMACKEY{i} (i=0..3) — Secure Boot CMAC Key {i}
  [31:0] CMACKEY{i} — Secure Boot CMAC Key {i} location in User Z1 OTP.
