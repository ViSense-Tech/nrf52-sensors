# f28003x_epg_mux_regs register map
Vendor: Texas Instruments
Peripheral module from a debugger description file (folder C2000).
Address unit: 16 bits
Registers are 32-bit, read-write, no defined reset value unless marked. A register's access mark holds for its fields unless they carry their own. Offsets are as the file gives them; lines under a group give offsets from that group; [hi:lo] are bit positions; {n}, {i} and the like mark numbered series; 'fields as' and 'values as' point back to an identical list; <NAME> marks a mode.

## EPG_MUX_REGS — EPG MUX Registers
0x0C EPGMXSELLOCK — EPG Mux select register lock
  [0] EPGMXSEL0 — EPGMXSEL0 lock bit
0x0E EPGMXSELCOMMIT — EPG Mux select register commit
  [0] EPGMXSEL0 — EPGMXSEL0 commit bit
