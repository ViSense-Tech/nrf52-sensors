# f28004x_clb_data_exchange_regs register map
Vendor: Texas Instruments
Peripheral module from a debugger description file (folder C2000).
Address unit: 16 bits
Registers are 32-bit, read-only, no defined reset value unless marked. A register's access mark holds for its fields unless they carry their own. Offsets are as the file gives them; lines under a group give offsets from that group; [hi:lo] are bit positions; {n}, {i} and the like mark numbered series; 'fields as' and 'values as' point back to an identical list; <NAME> marks a mode.

## CLB_DATA_EXCHANGE_REGS — CLB DATA EXCHANGE Registers
0x00 CLB_PUSH — CLB_PUSH FIFO Registers (from HLC)
  [31:0] PUSH — FIFO TO System From CLB
0x100 CLB_PULL rw — CLB_PULL FIFO Registers (TO HLC)
  [31:0] PULL — FIFO From system TO CLB
