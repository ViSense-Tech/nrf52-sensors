# VPAC0_COMMON_0_PAR_VPAC_VISS0_S_VBUSP_VISS_NSF4V_CFG_MEM_MMRRAM_VBUSP_MMR_RAM register map
Vendor: Texas Instruments
Peripheral module from a debugger description file (folder J7_AHP).
Registers are 32-bit, read-write, reset 0x0 unless marked. A register's access mark holds for its fields unless they carry their own. Offsets are as the file gives them; lines under a group give offsets from that group; [hi:lo] are bit positions; {n}, {i} and the like mark numbered series; 'fields as' and 'values as' point back to an identical list; <NAME> marks a mode.

## VPAC0_COMMON_0_PAR_VPAC_VISS0_S_VBUSP_VISS_NSF4V_CFG_MEM_MMRRAM_VBUSP_MMR_RAM
0x00 PAR_VPAC_VISS0__S_VBUSP__VISS_NSF4V__CFG__MEM_MMR__MMRRAM_VBUSP__MMR_RAM_DBG_MEM
  [31:0] DATA — Adr range selects which RAM address to index. (Wr or rd beyond populated RAM adr result in non productive cycles and rd returns zero)
