# COMPUTE_CLUSTER_J7AHP0_GIC500SS_0_GIC_TRANSLATER register map
Vendor: Texas Instruments
Peripheral module from a debugger description file (folder J7_AHP).
Registers are 32-bit, read-write, reset 0x0 unless marked. A register's access mark holds for its fields unless they carry their own. Offsets are as the file gives them; lines under a group give offsets from that group; [hi:lo] are bit positions; {n}, {i} and the like mark numbered series; 'fields as' and 'values as' point back to an identical list; <NAME> marks a mode.

## COMPUTE_CLUSTER_J7AHP0_GIC500SS_0_GIC_TRANSLATER
0x40 GIC_TRANSLATER_TRANSLATER__1_GITS_TRANSLATER
  [31:0] TRANSLATER__1_GITS_TRANSLATER__0_32
