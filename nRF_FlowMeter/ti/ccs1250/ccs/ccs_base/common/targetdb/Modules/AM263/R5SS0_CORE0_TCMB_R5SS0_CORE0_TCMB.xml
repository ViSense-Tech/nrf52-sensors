# R5SS0_CORE0_TCMB_R5SS0_CORE0_TCMB register map
Vendor: Texas Instruments
Peripheral module from a debugger description file (folder AM263).
Registers are 32-bit, read-write, reset 0x0 unless marked. A register's access mark holds for its fields unless they carry their own. Offsets are as the file gives them; lines under a group give offsets from that group; [hi:lo] are bit positions; {n}, {i} and the like mark numbered series; 'fields as' and 'values as' point back to an identical list; <NAME> marks a mode.

## R5SS0_CORE0_TCMB_R5SS0_CORE0_TCMB
0x00 R5SS0_CORE0_TCMB_START
  [31:0] START — TCMB start address
0xFFFC R5SS0_CORE0_TCMB_END
  [31:0] END — TCMB end address
