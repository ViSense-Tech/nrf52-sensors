# R5SS0_CORE0_TCMA_ROM_R5SS0_CORE0_TCMA_ROM register map
Vendor: Texas Instruments
Peripheral module from a debugger description file (folder AM263).
Registers are 32-bit, read-only, reset 0x0 unless marked. A register's access mark holds for its fields unless they carry their own. Offsets are as the file gives them; lines under a group give offsets from that group; [hi:lo] are bit positions; {n}, {i} and the like mark numbered series; 'fields as' and 'values as' point back to an identical list; <NAME> marks a mode.

## R5SS0_CORE0_TCMA_ROM_R5SS0_CORE0_TCMA_ROM
0x00 R5SS0_CORE0_TCMA_ROM_ROM_START_TCMA
  [31:0] ROM_START — ROM start address of master sub system tcma
0x1FFFC R5SS0_CORE0_TCMA_ROM_ROM_END_TCMA
  [31:0] ROM_END — ROM end address of master sub system tcma
