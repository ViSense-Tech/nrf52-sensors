# C2000_EV_B_Type0_Registers register map
Vendor: Texas Instruments
Peripheral module from a debugger description file (folder C2000).
Address unit: 16 bits
Registers are 16-bit, access not given, no defined reset value unless marked. A register's access mark holds for its fields unless they carry their own. Offsets are as the file gives them; lines under a group give offsets from that group; [hi:lo] are bit positions; {n}, {i} and the like mark numbered series; 'fields as' and 'values as' point back to an identical list; <NAME> marks a mode.

## EVB — EVB Registers
0x00 GPTCONB — 0x7500
0x01 T3CNT — 0x7501
0x02 T3CMPR — 0x7502
0x03 T3PR — 0x7503
0x04 T3CON — 0x7504
0x05 T4CNT — 0x7505
0x06 T4CMPR — 0x7506
0x07 T4PR — 0x7507
0x08 T4CON — 0x7508
0x09 EXTCONB — 0x7509
0x11 COMCONB — 0x7511
0x13 ACTRB — 0x7513
0x15 DBTCONB — 0x7515
{0x13+i} CMPR{i} (i=4..6) — {0x7513+i}
0x20 CAPCONB — 0x7520
0x22 CAPFIFOB — 0x7522
{0x1F+i} CAP{i}FIFO (i=4..6) — {0x751F+i}
{0x23+i} CAP{i}FBOT (i=4..6) — {0x7523+i}
0x2C EVBIMRA — 0x752C
0x2D EVBIMRB — 0x752D
0x2E EVBIMRC — 0x752E
0x2F EVBIFRA — 0x752F
0x30 EVBIFRB — 0x7530
0x31 EVBIFRC — 0x7531
