# 2805x_Interrupt_Registers register map
Vendor: Texas Instruments
Peripheral module from a debugger description file (folder C2000).
Address unit: 16 bits
Registers are 16-bit, access not given, no defined reset value unless marked. A register's access mark holds for its fields unless they carry their own. Offsets are as the file gives them; lines under a group give offsets from that group; [hi:lo] are bit positions; {n}, {i} and the like mark numbered series; 'fields as' and 'values as' point back to an identical list; <NAME> marks a mode.

## GPIO_INT_REGS — GPIO INT REGS Registers
0x00 GPIOXINT1SEL — XINT1 GPIO Input Select Register (GPIO0 to 31)
0x01 GPIOXINT2SEL — XINT2 GPIO Input Select Register (GPIO0 to 31)
0x02 GPIOXINT3SEL — XINT3 GPIO Input Select Register (GPIO0 to 31)
0x08 GPIOLPMSEL 32-bit — LPM GPIO Select Register (GPIO0 to 31)
