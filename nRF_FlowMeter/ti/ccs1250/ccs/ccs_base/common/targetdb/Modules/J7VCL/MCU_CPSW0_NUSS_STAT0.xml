# MCU_CPSW0_NUSS_STAT0 register map
Vendor: Texas Instruments
Peripheral module from a debugger description file (folder J7VCL).
Registers are 32-bit, read-write, reset 0x0 unless marked. A register's access mark holds for its fields unless they carry their own. Offsets are as the file gives them; lines under a group give offsets from that group; [hi:lo] are bit positions; {n}, {i} and the like mark numbered series; 'fields as' and 'values as' point back to an identical list; <NAME> marks a mode.

## MCU_CPSW0_NUSS_STAT0
0x3A000 CPSW_STAT0_RXGOODFRAMES — The total number of good frames received on the port. A good frame is defined to be:- Any data or MAC control frame which matched a unicast, broadcast or multicast address, or matched due to promiscuous mode- Had a length of 64 to SL_RX_MAXLEN[13-0] RX_MAXLEN bytes inclusive- Had no CRC error, alignment error or code error.See the RX_ALIGN_CODE_ERRORS and statistic descriptions for definitions of alignment, code and CRC errors. Overruns have no effect upon this statistic.
  [31:0] COUNT — Total number of good frames received.
0x3A004 CPSW_STAT0_RXBROADCASTFRAMES — The total number of good broadcast frames received on the port. A good broadcast frame is defined to be:- Any data or MAC control frame which was destined for only address 0xFFFFFFFFFFFF- Had a length of [13-0] RX_MAXLEN bytes inclusive- Had no CRC error, alignment error or code error.See the statistic descriptions for total number of CRC errors. Overruns have no effect upon this statistic.
  [31:0] COUNT — Total number of good broadcast frames received.
0x3A008 CPSW_STAT0_RXMULTICASTFRAMES — The total number of good multicast frames received on the port. A good multicast frame is defined to be:- Any data or MAC control frame which was destined for any multicast address other than 0xFFFFFFFFFFFF- Had a length of [13-0] RX_MAXLEN bytes inclusive- Had no CRC error, alignment error or code error.See the statistic descriptions for total number of CRC errors. Overruns have no effect upon this statistic.
  [31:0] COUNT — Total number of good multicast frames received.
0x3A010 CPSW_STAT0_RXCRCERRORS — The total number of frames received on the port that experienced a CRC error. Such a frame:- Was any data or MAC control frame which matched a unicast, broadcast or multicast address, or matched due to promiscuous mode- Was of length 64 to CPSW0_P0_RX_MAXLEN_REG[13-0] RX_MAXLEN bytes inclusive- Had no code/align error,- Had a CRC error Overruns have no effect upon this statistic.A CRC error is defined to be:- A frame containing an even number of nibbles- Failing the Frame Check Sequence test.
  [31:0] COUNT — Total number of CRC errors frames received.
0x3A018 CPSW_STAT0_RXOVERSIZEDFRAMES — The total number of oversized frames received on the port. An oversized frame is defined to be:- Was any data or MAC control frame which matched a unicast, broadcast or multicast address, or matched due to promiscuous mode- Was greater than [13-0] RX_MAXLEN in bytes- Had no CRC error, alignment error or code errorSee the statistic descriptions for total number of CRC errors. Overruns have no effect upon this statistic.
  [31:0] COUNT — Total number of oversized frames received.
0x3A020 CPSW_STAT0_RXUNDERSIZEDFRAMES — The total number of undersized frames received on the port. An undersized frame is defined to be:- Was any data frame which matched a unicast, broadcast or multicast address, or matched due to promiscuous mode- Was less than 64 octets long- Had no CRC error, alignment error or code errorSee the statistic descriptions for total number of CRC errors. Overruns have no effect upon this statistic.
  [31:0] COUNT — Total number of undersized frames received.
0x3A024 CPSW_STAT0_RXFRAGMENTS — The total number of frame fragments received on the port. A frame fragment is defined to be:- Any data frame (address matching does not matter)- Less than 64 bytes long- Having a CRC error, an alignment error, or a code error- Not the result of a collision caused by half duplex, collision based flow controlSee the statistic descriptions for total number of CRC errors. Overruns have no effect upon this statistic.
  [31:0] COUNT — Total number of fragmented frames received.
0x3A028 CPSW_STAT0_ALE_DROP — Total number of frames dropped by the ALE.
  [31:0] COUNT
0x3A02C CPSW_STAT0_ALE_OVERRUN_DROP — Total number of overrun frames dropped by the ALE.
  [31:0] COUNT
0x3A030 CPSW_STAT0_RXOCTETS — The total number of bytes in all good frames received on the port. A good frame is defined to be:- Any data or MAC control frame which matched a unicast, broadcast or multicast address, or matched due to promiscuous mode- Of length 64 to [13-0] RX_MAXLEN bytes inclusive- Had no CRC error, alignment error or code errorSee the statistic descriptions for total number of CRC errors. Overruns have no effect upon this statistic.
  [31:0] COUNT — Total number of received bytes in good frames
0x3A034 CPSW_STAT0_TXGOODFRAMES — The total number of good frames received on the port. A good frame is defined to be:- Any data or MAC control frame which matched a unicast, broadcast or multicast address, or matched due to promiscuous mode- Any length- Had no late or excessive collisions, no carrier loss and no underrun
  [31:0] COUNT — Total number of good frames transmitted
0x3A038 CPSW_STAT0_TXBROADCASTFRAMES — The total number of good broadcast frames received on the port. A good broadcast frame is defined to be:- Any data or MAC control frame which was destined for only address 0xFFFFFFFFFFFF- Any length- Had no late or excessive collisions, no carrier loss and no underrun
  [31:0] COUNT — Total number of good broadcast frames transmitted.
0x3A03C CPSW_STAT0_TXMULTICASTFRAMES — The total number of good multicast frames received on the port. A good multicast frame is defined to be:- Any data or MAC control frame which was destined for any multicast address other than 0xFFFFFFFFFFFF- Any length- Had no late or excessive collisions, no carrier loss and no underrun
  [31:0] COUNT — Total number of good multicast frames transmitted.
0x3A064 CPSW_STAT0_TXOCTETS — The total number of bytes in all good frames transmitted on the port. A good frame is defined to be:- Any data or MAC control frame which was destined for any unicast, broadcast or multicast address- Was any size- Had no late or excessive collisions, no carrier loss and no underrun.
  [31:0] COUNT — Total number of bytes in all good frames transmitted
0x3A068 CPSW_STAT0_OCTETFRAMES64 — The total number of 64-byte frames received and transmitted on the port. Such a frame is defined to be:- Any data or MAC control frame which was destined for any unicast, broadcast or multicast address- Did not experience late collisions, excessive collisions, or carrier sense error- Was exactly 64 bytes long. (If the frame was being transmitted and experienced carrier loss that resulted in a frame of this size being transmitted, then the frame will be recorded in this statistic).CRC errors, code/align errors and overruns do not affect the recording of frames in this statistic.
  [31:0] COUNT — Total number of 64-byte frames received and transmitted
0x3A06C CPSW_STAT0_OCTETFRAMES65T127 — The total number of frames of size 65 to 127 bytes received and transmitted on the port. Such a frame is defined to be:- Any data or MAC control frame which was destined for any unicast, broadcast or multicast address- Did not experience late collisions, excessive collisions, or carrier sense error- Was 65 to 127 bytes longCRC errors, code/align errors, underruns and overruns do not affect the recording of frames in this statistic.
  [31:0] COUNT — Total number of frames of size 65 to 127 bytes received and transmitted
0x3A070 CPSW_STAT0_OCTETFRAMES128T255 — The total number of frames of size 128 to 255 bytes received and transmitted on the port. Such a frame is defined to be:- Any data or MAC control frame which was destined for any unicast, broadcast or multicast address- Did not experience late collisions, excessive collisions, or carrier sense error- Was 128 to 255 bytes longCRC errors, code/align errors, underruns and overruns do not affect the recording of frames in this statistic.
  [31:0] COUNT — Total number of frames of size 128 to 255 bytes received and transmitted
0x3A074 CPSW_STAT0_OCTETFRAMES256T511 — The total number of frames of size 256 to 511 bytes received and transmitted on the port. Such a frame is defined to be:- Any data or MAC control frame which was destined for any unicast, broadcast or multicast address- Did not experience late collisions, excessive collisions, or carrier sense error- Was 256 to 511 bytes longCRC errors, code/align errors, underruns and overruns do not affect the recording of frames in this statistic.
  [31:0] COUNT — Total number of frames of size 256 to 511 bytes received and transmitted.
0x3A078 CPSW_STAT0_OCTETFRAMES512T1023 — The total number of frames of size 512 to 1023 bytes received and transmitted on the port. Such a frame is defined to be:- Any data or MAC control frame which was destined for any unicast, broadcast or multicast address- Did not experience late collisions, excessive collisions, or carrier sense error- Was 512 to 1023 bytes longCRC errors, code/align errors, underruns and overruns do not affect the recording of frames in this statistic.
  [31:0] COUNT — Total number of frames of size 512 to 1023 bytes received and transmitted.
0x3A07C CPSW_STAT0_OCTETFRAMES1024TUP — The total number of frames of size 1024 to [13-0] RX_MAXLEN bytes for receive or 1024 up for transmit on the port. Such a frame is defined to be:- Any data or MAC control frame which was destined for any unicast, broadcast or multicast address- Did not experience late collisions, excessive collisions, or carrier sense error- Was 1024 to [13-0] RX_MAXLEN bytes long on receive, or any size on transmitCRC errors, code/align errors, underruns and overruns do not affect the recording of frames in this statistic.
  [31:0] COUNT — Total number of frames of size 1024 to
0x3A080 CPSW_STAT0_NETOCTETS — The total number of bytes of frame data received and transmitted on the port. Each frame counted:- was any data or MAC control frame destined for any unicast, broadcast or multicast address (address match does not matter)- Any length (including less than 64 bytes and greater than [13-0] RX_MAXLEN bytes)Also counted in this statistic is:- Every byte transmitted before a carrier- loss was experienced- Every byte transmitted before each collision was experienced, (i.e. multiple retries are counted each time)- Every byte received if the port is in half-duplex mode until a jam sequence was transmitted to initiate flow control. (The jam sequence was not counted to prevent double-counting)Error conditions such as alignment errors, CRC errors, code errors, overruns and underruns do not affect the recording of bytes by this statistic. The objective of this statistic is to give a reasonable indication of ethernet utilization
  [31:0] COUNT — Total number of bytes received and transmitted
0x3A084 CPSW_STAT0_RX_BOTTOM_OF_FIFO_DROP — Receive Bottom of FIFO Drop.
  [31:0] COUNT
0x3A088 CPSW_STAT0_PORTMASK_DROP — Total number of dropped frames received due to portmask.
  [31:0] COUNT
0x3A08C CPSW_STAT0_RX_TOP_OF_FIFO_DROP — Receive Top of FIFO Drop.
  [31:0] COUNT
0x3A090 CPSW_STAT0_ALE_RATE_LIMIT_DROP — Total number of dropped frames due to ALE Rate Limiting.
  [31:0] COUNT
0x3A094 CPSW_STAT0_ALE_VID_INGRESS_DROP — Total number of dropped frames due to ALE VID Ingress.
  [31:0] COUNT
0x3A098 CPSW_STAT0_ALE_DA_EQ_SA_DROP — Total number of dropped frames due to DA=SA.
  [31:0] COUNT
0x3A09C CPSW_STAT0_ALE_BLOCK_DROP — Total number of dropped frames due to ALE Block Mode.
  [31:0] COUNT
0x3A0A0 CPSW_STAT0_ALE_SECURE_DROP — Total number of dropped frames due to ALE Secure Mode.
  [31:0] COUNT
0x3A0A4 CPSW_STAT0_ALE_AUTH_DROP — Total number of dropped frames due to ALE Authentication.
  [31:0] COUNT
0x3A0A8 CPSW_STAT0_ALE_UNKN_UNI — ALE Receive Unknown Unicast.
  [31:0] COUNT
0x3A0AC CPSW_STAT0_ALE_UNKN_UNI_BCNT — ALE Receive Unknown Unicast Bytecount.
  [31:0] COUNT
0x3A0B0 CPSW_STAT0_ALE_UNKN_MLT — ALE Receive Unknown Multicast.
  [31:0] COUNT
0x3A0B4 CPSW_STAT0_ALE_UNKN_MLT_BCNT — ALE Receive Unknown Multicast Bytecount.
  [31:0] COUNT
0x3A0B8 CPSW_STAT0_ALE_UNKN_BRD — ALE Receive Unknown Broadcast.
  [31:0] COUNT
0x3A0BC CPSW_STAT0_ALE_UNKN_BRD_BCNT — ALE Receive Unknown Broadcast Bytecount.
  [31:0] COUNT
0x3A0C0 CPSW_STAT0_ALE_POL_MATCH — ALE Policer Matched.
  [31:0] COUNT
0x3A0C4 CPSW_STAT0_ALE_POL_MATCH_RED — ALE Policer Matched and Condition Red.
  [31:0] COUNT
0x3A0C8 CPSW_STAT0_ALE_POL_MATCH_YELLOW — ALE Policer Matched and Condition Yellow.
  [31:0] COUNT
0x3A0CC CPSW_STAT0_ALE_MULT_SA_DROP — ALE Multicast Source Address Drop.
  [31:0] COUNT — ALE Multicast Source Address drop.
0x3A0D0 CPSW_STAT0_ALE_DUAL_VLAN_DROP — ALE Dual VLAN Drop.
  [31:0] COUNT — ALE Dual VLAN drop.
0x3A0D4 CPSW_STAT0_ALE_LEN_ERROR_DROP — ALE Length Error Drop.
  [31:0] COUNT — ALE Length Error drop.
0x3A0D8 CPSW_STAT0_ALE_IP_NEXT_HDR_DROP — ALE IP Next Header Drop.
  [31:0] COUNT — ALE Next Header drop.
0x3A0DC CPSW_STAT0_ALE_IPV4_FRAG_DROP — ALE IPV4 Frag Drop.
  [31:0] COUNT — ALE IPV4 Fragment drop.
0x3A140 CPSW_STAT0_IET_RX_ASSEMBLY_ERROR_REG — IET Receive Assembly Error. Note: IET functionallity is not supported for MCU_CPSW0 Port 0.
  [31:0] IET_RX_ASSEMBLY_ERROR — IET Receive Assembly ErrorNote: IET functionallity is not supported for MCU_CPSW0 Port 0.
0x3A144 CPSW_STAT0_IET_RX_ASSEMBLY_OK_REG — IET Receive Assembly Ok. Note: IET functionallity is not supported for MCU_CPSW0 Port 0.
  [31:0] IET_RX_ASSEMBLY_OK — IET Receive Assembly Ok.Note: IET functionallity is not supported for MCU_CPSW0 Port 0.
0x3A148 CPSW_STAT0_IET_RX_SMD_ERROR_REG — IET Receive Smd Error. Note: IET functionallity is not supported for MCU_CPSW0 Port 0.
  [31:0] IET_RX_SMD_ERROR — IET Receive Smd Error.Note: IET functionallity is not supported for MCU_CPSW0 Port 0.
0x3A14C CPSW_STAT0_IET_RX_FRAG_REG — IET Receive Frag. Note: IET functionallity is not supported for MCU_CPSW0 Port 0.
  [31:0] IET_RX_FRAG — IET Receive Frag.Note: IET functionallity is not supported for MCU_CPSW0 Port 0.
0x3A150 CPSW_STAT0_IET_TX_HOLD_REG — IET Transmit Hold. Note: IET functionallity is not supported for MCU_CPSW0 Port 0.
  [31:0] IET_TX_HOLD — IET Transmit Hold.Note: IET functionallity is not supported for MCU_CPSW0 Port 0.
0x3A154 CPSW_STAT0_IET_TX_FRAG_REG — IET Transmit Frag. Note: IET functionallity is not supported for MCU_CPSW0 Port 0.
  [31:0] IET_TX_FRAG — IET Transmit Frag.Note: IET functionallity is not supported for MCU_CPSW0 Port 0.
0x3A17C CPSW_STAT0_TX_MEMORY_PROTECT_ERROR — Transmit Memory Protect CRC Error.
  [7:0] COUNT — Transmit Memory Protect CRC Error.Note: If there is a memorry protect error, then this COUNT value will increment and issue a STAT_PEND0 interrupt, when this bit field is non-zero.That is different from the other stats which only issue an interrupt when their values are greater than 0xFFFF.
