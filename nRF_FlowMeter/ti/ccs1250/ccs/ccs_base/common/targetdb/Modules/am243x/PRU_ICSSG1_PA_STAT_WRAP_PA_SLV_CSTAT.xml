# PRU_ICSSG1_PA_STAT_WRAP_PA_SLV_CSTAT register map
Vendor: Texas Instruments
Peripheral module from a debugger description file (folder am243x).
Registers are 32-bit, read-write, reset 0x0 unless marked. A register's access mark holds for its fields unless they carry their own. Offsets are as the file gives them; lines under a group give offsets from that group; [hi:lo] are bit positions; {n}, {i} and the like mark numbered series; 'fields as' and 'values as' point back to an identical list; <NAME> marks a mode.

## PRU_ICSSG1_PA_STAT_WRAP_PA_SLV_CSTAT
0x00 PA_STAT_WRAP__PA_SLV__CSTAT_CRAM — query mode RAM
  [31:0] VALUE — collect statistic
