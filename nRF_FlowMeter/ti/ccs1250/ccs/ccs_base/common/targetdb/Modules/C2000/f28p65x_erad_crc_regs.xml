# f28p65x_erad_crc_regs register map
Vendor: Texas Instruments
Peripheral module from a debugger description file (folder C2000).
Address unit: 16 bits
Registers are 32-bit, read-write, no defined reset value unless marked. A register's access mark holds for its fields unless they carry their own. Offsets are as the file gives them; lines under a group give offsets from that group; [hi:lo] are bit positions; {n}, {i} and the like mark numbered series; 'fields as' and 'values as' point back to an identical list; <NAME> marks a mode.

## ERAD_CRC_REGS — ERAD CRC Registers
0x00 CRC_CURRENT ro
  [31:0] CRC_CURRENT — Current CRC Computed Value
0x02 CRC_SEED — CRC SEED value
0x04 CRC_QUALIFIER 16-bit
  [4:0] CRC_QUALIFIER
