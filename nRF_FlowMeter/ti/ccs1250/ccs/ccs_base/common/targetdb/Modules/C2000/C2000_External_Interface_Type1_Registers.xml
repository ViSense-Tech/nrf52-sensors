# C2000_External_Interface_Type1_Registers register map
Vendor: Texas Instruments
Peripheral module from a debugger description file (folder C2000).
Address unit: 16 bits
Registers are 32-bit, access not given, no defined reset value unless marked. A register's access mark holds for its fields unless they carry their own. Offsets are as the file gives them; lines under a group give offsets from that group; [hi:lo] are bit positions; {n}, {i} and the like mark numbered series; 'fields as' and 'values as' point back to an identical list; <NAME> marks a mode.

## XINTF — External Interface Configuration and Control
0x00 XTIMING0 — XINTF Timing Register, Zone 0
0x0C XTIMING6 — XINTF Timing Register, Zone 6
0x0E XTIMING7 — XINTF Timing Register, Zone 7
0x14 XINTCNF2 — XINTF Configuration Register
0x18 XBANK 16-bit — XINTF Bank Control Register
0x1A XREVISION 16-bit — XINTF Revision Register
0x1D XRESET 16-bit — XINTF Reset Register
