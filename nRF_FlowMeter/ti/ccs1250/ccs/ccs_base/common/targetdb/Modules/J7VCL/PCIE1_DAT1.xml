# PCIE1_DAT1 register map
Vendor: Texas Instruments
Peripheral module from a debugger description file (folder J7VCL).
Registers are 32-bit, read-write, reset 0x0 unless marked. A register's access mark holds for its fields unless they carry their own. Offsets are as the file gives them; lines under a group give offsets from that group; [hi:lo] are bit positions; {n}, {i} and the like mark numbered series; 'fields as' and 'values as' point back to an identical list; <NAME> marks a mode.

## PCIE1_DAT1
0x00 PCIE_DATA_MEM_y — PCIE data region1 Offset = 0h + (y * 4h); where y = 0h to 03FFFFFFh
  [31:0] PCIE_DATA — PCIE data region1
