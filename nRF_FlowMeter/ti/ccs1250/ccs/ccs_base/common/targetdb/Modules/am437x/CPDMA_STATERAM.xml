# CPDMA_STATERAM register map
Vendor: Texas Instruments
Peripheral module from a debugger description file (folder am437x).
Registers are 32-bit, read-write, no defined reset value unless marked. A register's access mark holds for its fields unless they carry their own. Offsets are as the file gives them; lines under a group give offsets from that group; [hi:lo] are bit positions; {n}, {i} and the like mark numbered series; 'fields as' and 'values as' point back to an identical list; <NAME> marks a mode.

## CPDMA_STATERAM
{0x0+4i} CPSW_STATERAM_TX{i}_HDP (i=0..7) — CPDMA_STATERAM TX CHANNEL {i} HEAD DESC POINTER *
  [31:0] TX_HDP — TX Channel (0..7) DMA Head Descriptor Pointer - Writing a TX DMA Buffer Descriptor address to a head pointer location initiates TX DMA operations in the queue for the selected channel. [[br]]Writing to these locations when they are non-zero is an error (except at reset). [[br]]Host software must initialize these locations to zero on reset. [[br]]
{0x20+4i} CPSW_STATERAM_RX{i}_HDP (i=0..7) — CPDMA_STATERAM RX {i} CHANNEL {i} HEAD DESC POINTER *
  [31:0] RX_HDP — RX DMA Head Descriptor Pointer - Writing an RX DMA Buffer Descriptor address to this location allows RX DMA operations in the selected channel when a channel frame is received. [[br]]Writing to these locations when they are non-zero is an error (except at reset). [[br]]Host software must initialize these locations to zero on reset. [[br]]
0x40 CPSW_STATERAM_TX0_CP — CPDMA_STATERAM TX CHANNEL 0 COMPLETION POINTER REGISTER
  [31:0] TX_CP — Tx Completion Pointer Register - This register is written by the host with the buffer descriptor address for the last buffer processed by the host during interrupt processing. [[br]]The port uses the value written to determine if the interrupt should be deasserted. [[br]]
{0x40+4i} CPSW_STATERAM_TX{i}_CP (i=1..7) — CPDMA_STATERAM TX CHANNEL {i} COMPLETION POINTER REGISTER *
  fields as CPSW_STATERAM_TX0_CP
{0x60+4i} CPSW_STATERAM_RX{i}_CP (i=0..7) — CPDMA_STATERAM RX CHANNEL {i} COMPLETION POINTER REGISTER *
  [31:0] RX_CP — Rx Completion Pointer Register - This register is written by the host with the buffer descriptor address for the last buffer processed by the host during interrupt processing. [[br]]The port uses the value written to determine if the interrupt should be deasserted. [[br]]Note: The value read is the completion pointer (interrupt acknowledge) value that was written by the CPDMA DMA controller (port). [[br]]The value written to this register by the host is compared with the value that the port wrote to determine if the interrupt should remain asserted. [[br]]The value written is not actually stored in the location. [[br]]The interrupt is deasserted if the two values are equal. [[br]]
