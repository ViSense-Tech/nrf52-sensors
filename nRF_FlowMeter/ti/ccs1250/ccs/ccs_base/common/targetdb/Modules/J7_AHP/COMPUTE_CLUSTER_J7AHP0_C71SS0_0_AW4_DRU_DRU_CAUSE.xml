# COMPUTE_CLUSTER_J7AHP0_C71SS0_0_AW4_DRU_DRU_CAUSE register map
Vendor: Texas Instruments
Peripheral module from a debugger description file (folder J7_AHP).
Registers are 64-bit, read-only, reset 0x0 unless marked. A register's access mark holds for its fields unless they carry their own. Offsets are as the file gives them; lines under a group give offsets from that group; [hi:lo] are bit positions; {n}, {i} and the like mark numbered series; 'fields as' and 'values as' point back to an identical list; <NAME> marks a mode.

## COMPUTE_CLUSTER_J7AHP0_C71SS0_0_AW4_DRU_DRU_CAUSE
0x00 AW4_DRU_DRU_CAUSE_cause
  [4n+3] R_ERR{n} (n=1..15) — Masked error bit for Tx channel n+{n}
  [4n+2] R_PEND{n} (n=1..15) — Masked completion ring pending bit for Rx channel n+{n}
  [4n+1] T_ERR{n} (n=1..15) — Masked error bit for Tx channel n+{n}
  [4n] T_PEND{n} (n=1..15) — Masked completion ring pending bit for Tx channel n+{n}
  [3] R_ERR0 — Masked error bit for Tx channel n
  [2] R_PEND0 — Masked completion ring pending bit for Rx channel n
  [1] T_ERR0 — Masked error bit for Tx channel n
  [0] T_PEND0 — Masked completion ring pending bit for Tx channel n
