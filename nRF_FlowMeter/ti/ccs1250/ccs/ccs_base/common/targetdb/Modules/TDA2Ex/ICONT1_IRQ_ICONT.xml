# ICONT1_IRQ_ICONT register map
Vendor: Texas Instruments
Peripheral module from a debugger description file (folder TDA2Ex).
Registers are 32-bit, access not given, reset 0x0 unless marked. A register's access mark holds for its fields unless they carry their own. Offsets are as the file gives them; lines under a group give offsets from that group; [hi:lo] are bit positions; {n}, {i} and the like mark numbered series; 'fields as' and 'values as' point back to an identical list; <NAME> marks a mode.

## ICONT1_IRQ_ICONT
0x20 ICONT_IRQ_EOI access per field — End Of Interrupt register - Interrupt handler
  [0] LINE_NUMBER rw — End Of Interrupt (EOI) control. Write number of interrupt output.
    0=EOI0 (EOI for interrupt handler interrupt output); 0=READ0 (Reads always 0 (no EOI memory))
0x24 ICONT_IRQSTATUS_RAW — Per-event raw interrupt status vector (interrupt handler). Raw status is set even if event is not enabled. Write 1 to set the (raw) status, mostly for debug.
  [31:0] IRQ31_1 — Settable raw status for interrupt event. For each bit of the bit field: Read 0: No event pending Read 1: Event pending Write 0: No action Write 1: Set event (debug) (access RW W1toSet)
0x28 ICONT_IRQSTATUS — Per-event 'enabled' interrupt status vector (interrupt handler). Enabled status is not set unless event is enabled. Write 1 to clear the status after interrupt has been serviced (raw status gets cleared, that is, even if not enabled).
  [31:0] IRQ31_0 — Clearable, enabled status for interrupt event. For each bit of the bit field: Read 0: No (enabled) event pending Read 1: Event pending Write 0: No action Write 1: Clear (raw) event (access RW W1toClr)
0x2C ICONT_IRQENABLE_SET — Per-event interrupt enable bit vector (interrupt handler). Write 1 to set (enable interrupt). Readout equal to corresponding _CLR register.
  [31:0] IRQ31_0 — Enable for interrupt event. For each bit of the bit field: Read 0: Interrupt disabled (masked) Read 1: Interrupt enabled Write 0: No action Write 1: Enable interrupt (access RW W1toSet)
0x30 ICONT_IRQENABLE_CLR — Per-event interrupt enable bit vector (interrupt handler). Write 1 to clear (disable interrupt). Readout equal to corresponding _SET register.
  [31:0] IRQ31_0 — Enable for interrupt event. For each bit of the bitfiled: Read 0: Interrupt disabled (masked) Read 1: Interrupt enabled Write 0: No action Write 1: Disable interrupt (access RW W1toClr)
0x40 ICONT_SWI_EOI access per field — End Of Interrupt register - Software interrupt
  [0] LINE_NUMBER rw — End Of Interrupt (EOI) control. Write number of interrupt output.
    0=EOI0 (EOI for software interrupt output); 0=READ0 (Reads always 0 (no EOI memory))
0x44 ICONT_SWISTATUS_RAW — Per-event raw interrupt status vector (software interrupt). Raw status is set even if event is not enabled. Write 1 to set the (raw) status, mostly for debug.
  [0] SWI_IRQ — Settable raw status for software interrupt event (access RW W1toSet)
    0=No_action; 0=No_event_pending; 1=Event_pending; 1=Set_event_(debug)
0x48 ICONT_SWISTATUS — Per-event 'enabled' interrupt status vector (software interrupt). Enabled status is not set unless event is enabled. Write 1 to clear the status after interrupt has been serviced (raw status gets cleared, that is, even if not enabled).
  [0] SWI_IRQ — Clearable, enabled status for software interrupt event (access RW W1toClr)
    0=No_action; 0=No_(enabled)_event_pending; 1=Event_pending; 1=Clear_(raw)_event
0x4C ICONT_SWIENABLE_SET — Per-event interrupt enable bit vector (software interrupt). Write 1 to set (enable interrupt). Readout equal to corresponding _CLR register.
  [0] SWI_IRQ — Enable for software interrupt event (access RW W1toSet)
    0=No_action; 0=Interrupt_disabled_(masked); 1=Interrupt_enabled; 1=Enable_interrupt
0x50 ICONT_SWIENABLE_CLR — Per-event interrupt enable bit vector (software interrupt). Write 1 to clear (disable interrupt). Readout equal to corresponding _SET register.
  [0] SWI_IRQ — Enable for software interrupt event (access RW W1toClr)
    0=No_action; 0=Interrupt_disabled_(masked); 1=Interrupt_enabled; 1=Disable_interrupt
0x60 ICONT_SYNCMASK rw reset 0xFFFFFFFF — This register allow to mask each input of Sync logic. When.SYN_IRQn is set, input event n is disabled When .SYNC_IRQn is cleared, input event n is enabled
  [31:0] SYNC_IRQ31_0 — Sync IRQ mask
0x64 ICONT_SYNCCLR — Clear Interrupt line This register is used to clear status bit of interrupt n. write 0: no effect write 1: clears corresponding bit in IRQ_SYNCSTATUS and IRQ_SYNCRAWSTATUS registers
  [31:0] SYNC_IRQ31_0 — Sync IRQ clear (access W W1toClr)
0x68 ICONT_SYNCSTATUS ro — Status of masked Sync interrupt input n 0: Interrupt n has not occured or masked 1: Interrupt n is enabled and has occured
  [31:0] SYNC_IRQ31_0 — Sync IRQ status
0x70 ICONT_SYNCRAWSTATUS ro — Status of Sync interrupt n input before mask 0: Interrupt n has not occured 1: Interrupt n has occured
  [31:0] SYNC_IRQ31_0 — Sync IRQ raw status
0x80 ICONT_SYNC_IRQ_EOI access per field — End Of Interrupt - SYNC interrupt
  [0] LINE_NUMBER rw — Software End Of Interrupt (EOI) control. Write number of interrupt output.
    0=EOI0 (EOI for SYNC interrupt output); 0=READ0 (Reads always 0 (no EOI memory))
0x84 ICONT_SYNC_IRQSTATUS_RAW — Per-event raw interrupt status vector. Raw status is set even if event is not enabled. Write 1 to set the (raw) status, mostly for debug.
  [0] SYNC_IRQ — Settable raw status for outgoing Sync IRQ event (access RW W1toSet)
    values as ICONT_SWISTATUS_RAW.SWI_IRQ
0x88 ICONT_SYNC_IRQSTATUS — Per-event 'enabled' interrupt status vector, line #0. Enabled status is not set unless event is enabled. Write 1 to clear the status after interrupt has been serviced (raw status gets cleared, that is, even if not enabled).
  [0] SYNC_IRQ — Clearable, enabled status for outgoing Sync IRQ event (access RW W1toClr)
    values as ICONT_SWISTATUS.SWI_IRQ
0x8C ICONT_SYNC_IRQENABLE_SET — Per-event interrupt enable bit vector. Write 1 to set (enable interrupt). Readout equal to corresponding _CLR register.
  [0] SYNC_IRQ — Enable for Outgoing Sync IRQ event (access RW W1toSet)
    values as ICONT_SWIENABLE_SET.SWI_IRQ
0x90 ICONT_SYNC_IRQENABLE_CLR — Per-event interrupt enable bit vector. Write 1 to clear (disable interrupt). Readout equal to corresponding _SET register.
  [0] SYNC_IRQ — Enable for Outgoing Sync IRQ event (access RW W1toClr)
    values as ICONT_SWIENABLE_CLR.SWI_IRQ
