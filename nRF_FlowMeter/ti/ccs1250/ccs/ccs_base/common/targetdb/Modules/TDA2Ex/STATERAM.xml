# STATERAM register map
Vendor: Texas Instruments
Peripheral module from a debugger description file (folder TDA2Ex).
Registers are 32-bit, read-write, reset 0x0 unless marked. A register's access mark holds for its fields unless they carry their own. Offsets are as the file gives them; lines under a group give offsets from that group; [hi:lo] are bit positions; {n}, {i} and the like mark numbered series; 'fields as' and 'values as' point back to an identical list; <NAME> marks a mode.

## STATERAM
{0x0+4i} TX{i}_HDP (i=0..7) — CPDMA_STATERAM TX channel {i} head descriptor pointer
  [31:0] TX_HDP — TX Channel (0..7) DMA Head Descriptor Pointer - Writing a TX DMA Buffer Descriptor address to a head pointer location initiates TX DMA operations in the queue for the selected channel. Writing to these locations when they are non-zero is an error (except at reset). Host software must initialize these locations to zero on reset.
{0x20+4i} RX{i}_HDP (i=0..5) — CPDMA_STATERAM RX {i} channel {i} head descriptor pointer
  [31:0] RX_HDP — RX DMA Head Descriptor Pointer - Writing an RX DMA Buffer Descriptor address to this location allows RX DMA operations in the selected channel when a channel frame is received. Writing to these locations when they are non-zero is an error (except at reset). Host software must initialize these locations to zero on reset.
0x38 RX6_HDP — CPDMA_STATERAM RX 6 channel 6 head desc pointer
  fields as RX0_HDP
0x3C RX7_HDP — CPDMA_STATERAM RX 7 channel 7 head desc pointer
  fields as RX0_HDP
{0x40+4i} TX{i}_CP (i=0..7) — CPDMA_STATERAM TX channel {i} completion pointer register
  [31:0] TX_CP — Tx Completion Pointer Register - This register is written by the host with the buffer descriptor address for the last buffer processed by the host during interrupt processing. The port uses the value written to determine if the interrupt should be deasserted.
{0x60+4i} RX{i}_CP (i=0..7) — CPDMA_STATERAM RX channel {i} completion pointer register
  [31:0] RX_CP — Rx Completion Pointer Register - This register is written by the host with the buffer descriptor address for the last buffer processed by the host during interrupt processing. The port uses the value written to determine if the interrupt should be deasserted. Note: The value read is the completion pointer (interrupt acknowledge) value that was written by the CPDMA DMA controller (port). The value written to this register by the host is compared with the value that the port wrote to determine if the interrupt should remain asserted. The value written is not actually stored in the location. The interrupt is deasserted if the two values are equal.
